## arch/arm64/configs/f2q_defconfig
```kconfig
# Kernel defconfig for Galaxy Fold 2
# Based on Samsung Open Source kernel

CONFIG_ARCH_QCOM=y
CONFIG_ARCH_SM8250=y
CONFIG_QCOM_BOARD_PLATFORMS=y
CONFIG_QCOM_TLMM=y

# Display
CONFIG_QCOM_MDSS=y
CONFIG_QCOM_MDSS_PLL=y
CONFIG_DSI_CMD_MODE_PANEL=y

# Audio
CONFIG_SND_SOC_QCOM=y
CONFIG_SND_SOC_MSM8998=y

# USB
CONFIG_USB_DWC3_QCOM=y
CONFIG_PHY_QCOM_USB3=y

# I2C
CONFIG_I2C_QUP=y

# SPI
CONFIG_SPI_QUP=y

# Sensors
CONFIG_SENSORS_QCOM_TSENS=y

# GPU
CONFIG_QCOM_ADRENO=y
CONFIG_QCOM_ADRENO_DEFAULT_GOVERNOR=y

# Modem
CONFIG_QCOM_SMSM=y
CONFIG_QCOM_SMD=y
CONFIG_QCOM_SMD_RPM=y

# RTC
CONFIG_RTC_DRV_QCOM_PM8XXX=y

# Power management
CONFIG_QCOM_PM=y
CONFIG_QCOM_CPUFREQ_HW=y

# Debugging
CONFIG_DEBUG_FS=y
CONFIG_KPROBES=y
```
